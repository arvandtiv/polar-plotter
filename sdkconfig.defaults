## sdkconfig.defaults
```kconfig
# Applied on first build (run: idf.py set-target esp32s3)
CONFIG_IDF_TARGET="esp32s3"
CONFIG_ESP_MAIN_TASK_STACK_SIZE=4096
CONFIG_FREERTOS_HZ=1000
# Native USB-Serial-JTAG console (ESP32-S3 Nano talks over USB-C)
CONFIG_ESP_CONSOLE_USB_SERIAL_JTAG=y
```
